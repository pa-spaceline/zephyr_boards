/* The BMM350 magnetometer and BMP581 barometer are disabled for now: the I3C
 * bus on this board locks up on startup with a busy wait. Keeping I3C off frees
 * flexcomm1 for the physical LPUART1 console, so this board uses the LPUART1
 * console and no USB CDC ACM console. Re-enable the sensors on I3C once the I3C
 * startup issue is resolved.
 */

&i3c0 {
	status = "disabled";
};

&bmm350_0 {
	status = "disabled";
};

&bmp581_0 {
	status = "disabled";
};
