## boards/nxp/mr_mcxn_t1/Kconfig.i3c_workaround
```kconfig
config MCXN_T1_I3C_WORKAROUND
	bool "Disable I3C and use the LPUART1 console"
	default y
	select SERIAL
	select CONSOLE
	select UART_CONSOLE
	select UART_LINE_CTRL
	imply I2C
```
